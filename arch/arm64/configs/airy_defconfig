## config/Kconfig.alk
```kconfig
# SPDX-License-Identifier: GPL-2.0-only
# ALK-6.6 Top-level Kconfig

menu "Airymax Kernel (ALK)"

config AIRY_SYSCALL
	bool "Enable Airymax syscalls (454-457)"
	depends on SECURITY_AIRY
	default y
	help
	  Enables the 4 Airymax system calls (numbers 454-457, avoiding
	  the x32 historical range 512-547) for agent capability
	  invocation, memory rotation control, scheduler control, and
	  cognition lifecycle notification. 20 reserved slots (458-477)
	  are kept for future extension.

config AIRY_COREKERN
	bool "Airymax Core-Kernel Enhancements (corekern/)"
	depends on SECURITY_AIRY
	default y
	help
	  Enables the Airymax core-kernel enhancement subsystem under
	  kernel/corekern/. This hosts the sched_tac kernel side
	  (stc_policy/dispatch/mcs_map/stats), io_uring IPC kernel side
	  (airy_uring_cmd/ring/fastpath/zero_copy), agent 8-state
	  lifecycle (taskflow), kernel memory tiering, time/object/
	  locking/irq helpers, and eBPF struct_ops probes.

	  Subdirectories: api/ sched/ ipc/ taskflow/ memory/ time/
	  object/ locking/ irq/ bpf/.

config AIRY_LOG
	bool "Airyx Unified Logging (A-ULP) kernel side"
	depends on SECURITY_AIRY
	default y
	help
	  Enables the Airymax Unified Logging Protocol kernel side
	  under kernel/log/. Provides printk 8-level mapping, 128B
	  fixed-size log record ring buffer (alloc_pages + mmap), and
	  PMEM persistence backend.

config AIRY_IPC
	bool "Airymax IPC kernel infrastructure"
	depends on SECURITY_AIRY
	default y
	help
	  Enables the Airymax IPC kernel infrastructure under
	  kernel/ipc/. Hosts the IPC system-call entry shim and the
	  capability-folding Native-Word badge verifier. The IPC data
	  plane itself is carried by io_uring IORING_OP_URING_CMD
	  (zero-syscall fast path); this directory provides only the
	  control-plane helpers.

endmenu
```

## security/airy/Kconfig
```kconfig
# SPDX-License-Identifier: GPL-2.0-only
#
# Airy Pure-C LSM — Kernel Configuration
#

config SECURITY_AIRY
	bool "Airymax Pure-C LSM (Airy)"
	depends on SECURITY
	depends on IO_URING
	select AIRY_IPC
	select AIRY_COREKERN
	select AIRY_SYSCALL
	select AIRY_LOG
	default n
	help
	  A pure-C Linux Security Module for the Airymax agent runtime.
	  Provides capability-based security, agent lifecycle supervision,
	  IPC ring freezing, and die_notifier fault handling.

	  Unlike BPF-based LSMs, Airy implements all hooks directly in C,
	  enabling formal verification and deterministic enforcement.

	  If unsure, say N.

config AIRY_IPC
	bool "Airymax IPC fabric (kernel/ipc)"
	default n
	help
	  Airymax IPC capability and ring-buffer support. Provides the
	  global agent_caps[] array and airy_cap_agent_caps_init() required
	  by the Airy LSM. Selected automatically by SECURITY_AIRY.

config AIRY_COREKERN
	bool "Airymax core-kernel enhancements (kernel/corekern)"
	default n
	help
	  Airymax core-kernel subsystems: IPC fastpath, memory tiers,
	  task lifecycle, locking, time, IRQ, object system. Selected
	  automatically by SECURITY_AIRY.

config AIRY_SYSCALL
	bool "Airymax syscall surface (kernel/syscalls)"
	default n
	help
	  Airymax system calls (548-551). Selected automatically by
	  SECURITY_AIRY.

config AIRY_LOG
	bool "Airymax logging subsystem (kernel/log)"
	default n
	help
	  Airymax unified logging and printk ring buffer. Selected
	  automatically by SECURITY_AIRY.

config AIRY_CAP_TABLE_SIZE
	int "Airy capability table size"
	depends on SECURITY_AIRY
	default 1024
	range 64 4096
	help
	  Number of capability slots in the global agent capability table.
	  Each slot is 64 bytes. Total memory = AIRY_CAP_TABLE_SIZE * 64.

config AIRY_KUNIT
	bool "Airy KUnit regression tests" if !KUNIT_ALL_TESTS
	depends on KUNIT
	depends on SECURITY_AIRY
	default KUNIT_ALL_TESTS
	help
	  KUnit regression tests for the Airy P1 fixes (P1-1/4/5/8/10) plus the
	  IPC fastpath micro-benchmark (v3.6 closure item: measured Badge and
	  fastpath latency replacing design estimates).  Builds:
	    - security/airy/airy_lsm_test.c            (P1-4 Badge validation)
	    - security/airy/airy_cap_derive_test.c     (P1-10 COPY downgrade)
	    - kernel/ipc/airy_ipc_capability_test.c    (P1-5 AIRY_ALIGNED layout)
	    - kernel/corekern/ipc/airy_ipc_ring_test.c (P1-8 cancelBadgedSends)
	    - kernel/corekern/ipc/airy_fastpath_bench.c (fastpath micro-benchmark)
	    - kernel/corekern/sched/stc_dispatch_test.c (P1-1 log rate-limit)

	  Each test exercises the fixed path with no functional change to
	  production code.  Say N if unsure.
```
